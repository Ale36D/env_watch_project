## project/Kconfig.tmp
```kconfig
source "H:/individual/Code/SiFli/SiFli-SDK/customer/boards/sf32lb52-lchspi-ulp/hcpu/Kconfig.board"
source "$SIFLI_SDK/customer/boards/Kconfig.v2"
source "$SIFLI_SDK/Kconfig.v2"
orsource "sf-pkgs/Kconfig.conandeps"
rsource "Kconfig.proj"
```

## project/build_sf32lb52-lchspi-ulp_hcpu/Kconfig
```kconfig
source "$SIFLI_SDK/Kconfig.v2"
source "$SIFLI_SDK/customer/boards/Kconfig.v2"
source "H:/individual/Code/SiFli/SiFli-SDK/customer/boards/sf32lb52-lchspi-ulp/hcpu/Kconfig.board"
osource "H:/individual/graduationProject/project/lvgl_v8_control/project/sf-pkgs/Kconfig.conandeps"
source "H:/individual/graduationProject/project/lvgl_v8_control/project/Kconfig.proj"
```

## project/build_sf32lb52-lchspi-ulp_hcpu/ftab/Kconfig
```kconfig
source "$SIFLI_SDK/Kconfig.v2"
source "$SIFLI_SDK/customer/boards/Kconfig.v2"
source "H:/individual/Code/SiFli/SiFli-SDK/customer/boards/sf32lb52-lchspi-ulp/hcpu/Kconfig.board"
osource "H:/individual/Code/SiFli/SiFli-SDK/example/flash_table/sf32lb52x_common_v2/sf-pkgs/Kconfig.conandeps"
source "H:/individual/Code/SiFli/SiFli-SDK/example/flash_table/sf32lb52x_common_v2/Kconfig.proj"
```

## project/build_sf32lb52-lchspi-ulp_hcpu/lcpu/Kconfig
```kconfig
source "$SIFLI_SDK/Kconfig.v2"
source "$SIFLI_SDK/customer/boards/Kconfig.v2"
source "H:/individual/Code/SiFli/SiFli-SDK/customer/boards/sf32lb52-lchspi-ulp/lcpu/Kconfig.board"
osource "H:/individual/Code/SiFli/SiFli-SDK/example/ble/lcpu_general/project/common/sf-pkgs/Kconfig.conandeps"
source "H:/individual/Code/SiFli/SiFli-SDK/example/ble/lcpu_general/project/common/Kconfig.proj"
```
